## boards/others/esp32_2432s028/Kconfig
```kconfig
# Copyright (c) 2026
# SPDX-License-Identifier: Apache-2.0
config HEAP_MEM_POOL_ADD_SIZE_BOARD
	int
	default 4096 if BOARD_ESP32_2432S028_ESP32_PROCPU
```

## boards/others/esp32_2432s028/Kconfig.esp32_2432s028
```kconfig
# Copyright (c) 2026
# SPDX-License-Identifier: Apache-2.0
config BOARD_ESP32_2432S028
	select SOC_ESP32_WROOM_32UE_N4
	select SOC_ESP32_PROCPU if BOARD_ESP32_2432S028_ESP32_PROCPU
```

## boards/others/esp32_2432s028/board.yml
```yaml
board:
  name: esp32_2432s028
  full_name: ESP32-2432S028 (Cheap Yellow Display)
  vendor: sunton
  socs:
  - name: esp32
```
